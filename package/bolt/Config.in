## package/bolt/Config.in
```kconfig
config BR2_PACKAGE_BOLT
	bool "bolt"
	depends on BR2_PACKAGE_HOST_GOLANG
	help
	  An embedded key/value database for Go.

	  https://github.com/boltdb/bolt
```

## package/embd/Config.in
```kconfig
config BR2_PACKAGE_EMBD
	bool "embd"
	depends on BR2_PACKAGE_HOST_GOLANG
	help
	  Golang Embedded Programming Framework

	  http://embd.io
```

## package/golang-gb/Config.in.host
```kconfig
config BR2_PACKAGE_HOST_GOLANG_GB
	bool "golang-gb"
	depends on BR2_PACKAGE_HOST_GOLANG
	help
          gb is an alternative build tool for the Go programming language.

	  https://getgb.io
```

## package/golang/Config.in.host
```kconfig
config BR2_PACKAGE_HOST_GOLANG
	bool "golang"
	depends on BR2_TOOLCHAIN_HAS_THREADS
	help
	  Go build system. It is used to cros-compile Go programs for the target.

	  http://golang.org/
```

## package/rtop/Config.in
```kconfig
config BR2_PACKAGE_RTOP
	bool "rtop"
	depends on BR2_PACKAGE_HOST_GOLANG
	help
	  rtop is an interactive, remote system monitoring tool based on SSH

	  https://github.com/rapidloop/rtop
```
